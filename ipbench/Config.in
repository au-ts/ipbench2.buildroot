## ipbench/Config.in
```kconfig
comment "ipbench needs a toolchain w/ threads"
    depends on !BR2_TOOLCHAIN_HAS_THREADS

config BR2_PACKAGE_IPBENCH2
	bool "ipbench2"
	depends on BR2_TOOLCHAIN_HAS_THREADS
	depends on BR2_PACKAGE_PYTHON3
	select BR2_PACKAGE_PYTHON_LXML
	select BR2_PACKAGE_HOST_PYTHON3
	select BR2_PACKAGE_HOST_SWIG
	help
	  A benchmark suite for repeatable and reliable testing of IP networks.

	  https://github.com/au-ts/ipbench
```
